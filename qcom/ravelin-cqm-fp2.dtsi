// SPDX-License-Identifier: BSD-3-Clause
/*
 * Copyright (c) Qualcomm Technologies, Inc. and/or its subsidiaries.
 */

#include "ravelin.dtsi"

/ {
	model = "Qualcomm Technologies, Inc. Ravelin-CQM-FP2 SoC";
	compatible = "qcom,ravelin";
};
