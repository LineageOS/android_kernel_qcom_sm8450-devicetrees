// SPDX-License-Identifier: BSD-3-Clause
/*
 * Copyright (c) Qualcomm Technologies, Inc. and/or its subsidiaries.
 */

/dts-v1/;

#include "ravelin-cqs-fp1.dtsi"

/ {
	model = "Qualcomm Technologies, Inc. Ravelin-CQS-FP1 SoC";
	compatible = "qcom,ravelin";
	qcom,board-id = <0 0>;
	qcom,msm-id = <774 0x10000>;
	qcom,softsku-id = <1>;
};

&pcie0 {
	status = "okay";
};

&pcie0_msi {
	status = "okay";
};
