// SPDX-License-Identifier: BSD-3-Clause
/*
 * Copyright (c) Qualcomm Technologies, Inc. and/or its subsidiaries.
 */

#include "ravelinp.dtsi"

/ {
	model = "Qualcomm Technologies, Inc. Ravelin-CQS-FP2 SoC";
	compatible = "qcom,ravelin";
};
