/dts-v1/;

#include "cape.dtsi"

/ {
	model = "Qualcomm Technologies, Inc. CapeP SoC";
	compatible = "qcom,capep", "qcom,cape";
	qcom,msm-id = <531 0x10000>;
	qcom,board-id = <0 0>;
};

&soc {
	qcom,rmnet-ipa {
		status = "disabled";
	};
};

&ipa_hw {
	status = "disabled";
};
