// SPDX-License-Identifier: BSD-3-Clause
/*
 * Copyright (c) Qualcomm Technologies, Inc. and/or its subsidiaries.
 */

/dts-v1/;

#include "ravelin-cqm-fp2.dtsi"

/ {
	model = "Qualcomm Technologies, Inc. Ravelin-CQM-FP2 SoC";
	compatible = "qcom,ravelin";
	qcom,board-id = <0 0>;
	qcom,msm-id = <773 0x10000>;
	qcom,softsku-id = <2>;
};

&pcie0 {
	status = "disabled";
};

&pcie0_msi {
	status = "disabled";
};
